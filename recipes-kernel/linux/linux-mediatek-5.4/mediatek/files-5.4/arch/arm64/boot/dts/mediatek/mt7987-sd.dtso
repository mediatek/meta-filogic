/* SPDX-License-Identifier: (GPL-2.0 OR MIT) */

/dts-v1/;
/plugin/;

/ {
	reg_3p3v: regulator-3p3v {
		compatible = "regulator-fixed";
		regulator-name = "fixed-3.3V";
		regulator-min-microvolt = <3300000>;
		regulator-max-microvolt = <3300000>;
		regulator-boot-on;
		regulator-always-on;
	};

	fragment@0 {
		target = <&mmc0>;
		__overlay__ {
			pinctrl-names = "default", "state_uhs";
			pinctrl-0 = <&sd_pins_default>;
			pinctrl-1 = <&sd_pins_uhs>;
			bus-width = <4>;
			max-frequency = <52000000>;
			cap-sd-highspeed;
			vmmc-supply = <&reg_3p3v>;
			vqmmc-supply = <&reg_3p3v>;
			no-mmc;
			no-sdio;
			status = "okay";
		};
	};
};
