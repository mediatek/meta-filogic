/* SPDX-License-Identifier: (GPL-2.0 OR MIT) */

/dts-v1/;
/plugin/;

/ {
	reg_1p8v: regulator-1p8v {
		compatible = "regulator-fixed";
		regulator-name = "fixed-1.8V";
		regulator-min-microvolt = <1800000>;
		regulator-max-microvolt = <1800000>;
		regulator-boot-on;
		regulator-always-on;
	};

	reg_3p3v: regulator-3p3v {
		compatible = "regulator-fixed";
		regulator-name = "fixed-3.3V";
		regulator-min-microvolt = <3300000>;
		regulator-max-microvolt = <3300000>;
		regulator-boot-on;
		regulator-always-on;
	};

	fragment@0 {
		target = <&mmc0>;
		__overlay__ {
			pinctrl-names = "default", "state_uhs";
			pinctrl-0 = <&mmc_pins_default>;
			pinctrl-1 = <&mmc_pins_uhs>;
			bus-width = <8>;
			max-frequency = <200000000>;
			cap-mmc-highspeed;
			vqmmc-supply = <&reg_3p3v>;
			vmmc-supply = <&reg_3p3v>;
			non-removable;
			no-sd;
			no-sdio;
			status = "okay";
		};
	};
};
