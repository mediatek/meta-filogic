## conf/layer.conf
```bitbake
# We have a conf and classes directory, add to BBPATH
BBPATH .= ":${LAYERDIR}"

# We have a recipes-* directories, add to BBFILES
BBFILES += "${LAYERDIR}/recipes-*/*/*.bb \
	${LAYERDIR}/recipes-*/*/*.bbappend"

BBFILE_COLLECTIONS += "filogic"
BBFILE_PATTERN_filogic = "^${LAYERDIR}/"
BBFILE_PRIORITY_filogic = "8"

LAYERSERIES_COMPAT_filogic = "dunfell kirkstone"

BBMASK .= "${@bb.utils.contains('DISTRO_FEATURES', 'OneWifi', '', '|meta-cmf-filogic/recipes-ccsp/hal/', d)}"
BBMASK .= "${@bb.utils.contains('DISTRO_FEATURES', 'OneWifi', '|meta-cmf-filogic/recipes-connectivity/wpa-supplicant/', '|meta-cmf-filogic/recipes-connectivity/wpa-supplicant-onewifi/', d)}"
```

## conf/machine/filogic-32bit.conf
```bitbake
#@TYPE: Machine
#@NAME: mediatek filogic
#@NEEDED_BSPLAYERS: meta-filogic
#@DESCRIPTION: Machine configuration for running a RDK broadband on mediatek filogic
#@RDK_FLAVOR: rdkb

DEFAULTTUNE ?= "cortexa7"

require conf/machine/include/tune-cortexa7-soft.inc
include conf/machine/include/soc-family.inc

SOC_FAMILY = "mediatek"

MACHINEOVERRIDES .="${@bb.utils.contains('DISTRO_FEATURES','switch_gsw_mode',':gsw','',d)}"

KERNEL_DEVICETREE_gsw = " \
    mt7986a-2500wan-gsw-spim-nand-rfb.dtb \
    mt7986b-2500wan-gsw-spim-nand-rfb.dtb \
    "
    
KERNEL_DEVICETREE ?= " \
    mt7986a-2500wan-spim-nand-rfb.dtb \
    mt7986b-2500wan-spim-nand-rfb.dtb \
    "
KERNEL_IMAGETYPE = "fitImage"
KERNEL_CLASSES = "kernel-fitimage"

UBOOT_CONFIG = "mt7629_rfb_defconfig"

UBOOT_ARCH = "arm"
UBOOT_LOADADDRESS = "0x48008000"
UBOOT_ENTRYPOINT = "0x48008000"
MACHINE_EXTRA_RRECOMMENDS += "kernel-modules"

TCLIBC = "glibc"

MACHINEOVERRIDES .= ":broadband:filogic"

PREFERRED_VERSION_linux-libc-headers = "5.4.%"
PREFERRED_PROVIDER_hal-wifi = "hal-wifi-cfg80211"
PREFERRED_VERSION_iw_filogic = "5.%"
PREFERRED_VERSION_hostapd = "2.10"
PREFERRED_VERSION_wpa-supplicant = "2.10"

IMAGE_FSTYPES ="${@bb.utils.contains('DISTRO_FEATURES','kernel_in_ubi',' squashfs-xz',' ubi',d)}"
IMAGE_FSTYPES_DEBUGFS = ""
IMAGE_GEN_DEBUGFS = "0"
# Parameters for MT7986 RFB1 NAND (byte)
# NAND_LOG_BLOCK_SIZE = NAND_PHY_BLOCK_SIZE - 2 Pages
# NAND_LBLOCK_COUNT = NAND_PHY_BLOCK_COUNT - 53
NAND_PAGE_SIZE = "4096"
NAND_PHY_BLOCK_SIZE = "262144"
NAND_LOG_BLOCK_SIZE = "253952"
NAND_PHY_BLOCK_COUNT = "2048"
NAND_LOG_BLOCK_COUNT = "1920"

UBI_VOLNAME = "rootfs"
MKUBIFS_ARGS = "--min-io-size ${NAND_PAGE_SIZE} --leb-size ${NAND_LOG_BLOCK_SIZE} --max-leb-cnt ${NAND_LOG_BLOCK_COUNT}"
UBINIZE_ARGS = "--min-io-size ${NAND_PAGE_SIZE} --peb-size ${NAND_PHY_BLOCK_SIZE} --sub-page-size ${NAND_PAGE_SIZE}"
IMAGE_CLASSES += "image_types-mtk"

SERIAL_CONSOLE ?= "115200 ttyS0"
```

## conf/machine/filogic-kernelv6.conf
```bitbake
#@TYPE: Machine
#@NAME: mediatek filogic
#@NEEDED_BSPLAYERS: meta-filogic
#@DESCRIPTION: Machine configuration for running a RDK broadband on mediatek filogic
#@RDK_FLAVOR: rdkb

DEFAULTTUNE ?= "cortexa53"

include conf/machine/include/soc-family.inc

SOC_FAMILY = "mediatek"

MACHINEOVERRIDES .="${@bb.utils.contains('DISTRO_FEATURES','switch_gsw_mode',':gsw','',d)}"
MACHINEOVERRIDES .="${@bb.utils.contains('DISTRO_FEATURES','emmc',':emmc','',d)}"
MACHINEOVERRIDES .="${@bb.utils.contains('DISTRO_FEATURES','usb3',':usb3','',d)}"


KERNEL_DEVICETREE_mt7988d = " \
    mediatek/mt7988d-rfb.dtb  \
    mediatek/mt7988a-rfb-emmc.dtbo \
    mediatek/mt7988a-rfb-sd.dtbo \
    mediatek/mt7988a-rfb-snfi-nand.dtbo \
    mediatek/mt7988a-rfb-spim-nand.dtbo \
    mediatek/mt7988a-rfb-spim-nand-factory.dtbo \
    mediatek/mt7988a-rfb-spim-nand-nmbm.dtbo \
    mediatek/mt7988a-rfb-spim-nor.dtbo \
    mediatek/mt7988a-rfb-eth1-i2p5g-phy.dtbo \
    mediatek/mt7988a-rfb-eth2-aqr.dtbo \
    mediatek/mt7988a-rfb-eth2-mxl.dtbo \
    mediatek/mt7988a-rfb-spidev.dtbo \
    mediatek/mt7988a-rfb-eth2-sfp.dtbo \
    mediatek/mt7988d-rfb-eth0-gsw.dtbo \
    "

KERNEL_DEVICETREE_mt7988a = " \
    mediatek/mt7988a-rfb.dtb \
    mediatek/mt7988a-rfb-emmc.dtbo \
    mediatek/mt7988a-rfb-sd.dtbo \
    mediatek/mt7988a-rfb-snfi-nand.dtbo \
    mediatek/mt7988a-rfb-spim-nand.dtbo \
    mediatek/mt7988a-rfb-spim-nand-factory.dtbo \
    mediatek/mt7988a-rfb-spim-nand-nmbm.dtbo \
    mediatek/mt7988a-rfb-spim-nor.dtbo \
    mediatek/mt7988a-rfb-eth0-gsw.dtbo \
    mediatek/mt7988a-rfb-eth1-aqr.dtbo \
    mediatek/mt7988a-rfb-eth1-an8831x.dtbo \
    mediatek/mt7988a-rfb-eth1-cux3410.dtbo \
    mediatek/mt7988a-rfb-eth1-i2p5g-phy.dtbo \
    mediatek/mt7988a-rfb-eth1-mxl.dtbo \
    mediatek/mt7988a-rfb-eth1-sfp.dtbo \
    mediatek/mt7988a-rfb-eth2-aqr.dtbo \
    mediatek/mt7988a-rfb-eth2-an8831x.dtbo \
    mediatek/mt7988a-rfb-eth2-cux3410.dtbo \
    mediatek/mt7988a-rfb-eth2-mxl.dtbo \
    mediatek/mt7988a-rfb-eth2-sfp.dtbo \
    mediatek/mt7988a-rfb-spidev.dtbo \
    mediatek/mt7988a-rfb-4pcie.dtbo \
    mediatek/mt7988a-rfb-2pcie.dtbo \
    mediatek/mt7988d-rfb-2pcie.dtbo \
    "

KERNEL_DEVICETREE_mt7988_bpi4 = " \
    mediatek/mt7988a-bananapi-bpi-r4.dtb \
    mediatek/mt7988a-bananapi-bpi-r4-emmc.dtbo \
    mediatek/mt7988a-bananapi-bpi-r4-rtc.dtbo \
    mediatek/mt7988a-bananapi-bpi-r4-sd.dtbo \
    mediatek/mt7988a-bananapi-bpi-r4-wifi-mt7996a.dtbo \
    "
KERNEL_DEVICETREE_mt7987 = " \
    mediatek/mt7987a-rfb.dtb \
    mediatek/mt7987-spim-nand-nmbm.dtbo \
    mediatek/mt7987-spim-nand.dtbo \
    mediatek/mt7987-spidev.dtbo \
    mediatek/mt7987-spim-nor.dtbo \
    mediatek/mt7987-emmc.dtbo \
    mediatek/mt7987-sd.dtbo \
    mediatek/mt7987-netsys-eth0-an8801sb.dtbo \
    mediatek/mt7987-netsys-eth0-an8855.dtbo \
    mediatek/mt7987-netsys-eth0-an8855-gsw.dtbo \
    mediatek/mt7987-netsys-eth0-e2p5g.dtbo \
    mediatek/mt7987-netsys-eth0-mt7531.dtbo \
    mediatek/mt7987-netsys-eth0-mt7531-gsw.dtbo \
    mediatek/mt7987-netsys-eth1-i2p5g.dtbo \
    mediatek/mt7987-netsys-eth2-an8801sb.dtbo \
    mediatek/mt7987-netsys-eth2-e2p5g.dtbo \
    mediatek/mt7987-netsys-eth2-sfp.dtbo \
    mediatek/mt7987-netsys-eth2-usb.dtbo \
    "

KERNEL_IMAGETYPE = "fitImage"
KERNEL_CLASSES = "kernel-fitimage"
FIT_HASH_ALG ="sha1"
KERNEL_CLASSES += "${@bb.utils.contains('DISTRO_FEATURES','secure_boot',' kernel_secure_boot-filogic','',d)}"
KERNEL_CLASSES += "itb-image"
UBOOT_CONFIG = "mt7622_rfb_defconfig"

UBOOT_ARCH = "arm64"
UBOOT_LOADADDRESS = "0x46000000"
UBOOT_ENTRYPOINT = "0x46000000"
UBOOT_DTB_LOADADDRESS = "0x45f00000"
UBOOT_LOADADDRESS_mt7987 = "0x40000000"
UBOOT_ENTRYPOINT_mt7987 = "0x40000000"
UBOOT_DTB_LOADADDRESS_mt7987 = "0x4ff00000"

MACHINE_EXTRA_RRECOMMENDS += "kernel-modules"

TCLIBC = "glibc"

MACHINEOVERRIDES .= ":broadband:filogic"

IMAGE_FSTYPES ="${@bb.utils.contains('DISTRO_FEATURES','kernel_in_ubi',' squashfs-xz',' ubi',d)}"
IMAGE_FSTYPES_DEBUGFS = ""
IMAGE_GEN_DEBUGFS = "0"
# Parameters for MT7986 RFB1 NAND (byte)
# NAND_LOG_BLOCK_SIZE = NAND_PHY_BLOCK_SIZE - 2 Pages
# NAND_LBLOCK_COUNT = NAND_PHY_BLOCK_COUNT - 53
NAND_PAGE_SIZE = "4096"
NAND_PHY_BLOCK_SIZE = "262144"
NAND_LOG_BLOCK_SIZE = "253952"
NAND_PHY_BLOCK_COUNT = "2048"
NAND_LOG_BLOCK_COUNT = "1920"

UBI_VOLNAME = "rootfs"
MKUBIFS_ARGS = "--min-io-size ${NAND_PAGE_SIZE} --leb-size ${NAND_LOG_BLOCK_SIZE} --max-leb-cnt ${NAND_LOG_BLOCK_COUNT}"
UBINIZE_ARGS = "--min-io-size ${NAND_PAGE_SIZE} --peb-size ${NAND_PHY_BLOCK_SIZE} --sub-page-size ${NAND_PAGE_SIZE}"
IMAGE_CLASSES += "image_types-mtk"

SERIAL_CONSOLE ?= "115200 ttyS0"


require conf/machine/include/arm/armv8a/tune-cortexa53.inc
```

## conf/machine/filogic.conf
```bitbake
#@TYPE: Machine
#@NAME: mediatek filogic
#@NEEDED_BSPLAYERS: meta-filogic
#@DESCRIPTION: Machine configuration for running a RDK broadband on mediatek filogic
#@RDK_FLAVOR: rdkb

DEFAULTTUNE ?= "cortexa53"

include conf/machine/include/soc-family.inc

SOC_FAMILY = "mediatek"

MACHINEOVERRIDES .="${@bb.utils.contains('DISTRO_FEATURES','switch_gsw_mode',':gsw','',d)}"
MACHINEOVERRIDES .="${@bb.utils.contains('DISTRO_FEATURES','emmc',':emmc','',d)}"

KERNEL_DEVICETREE_mt7988_mt7988d_gsw = " \
    mediatek/mt7988d-gsw-10g-spim-nand.dtb \
    "

KERNEL_DEVICETREE_mt7988_mt7988d = " \
    mediatek/mt7988d-dsa-10g-spim-nand.dtb \
    "

KERNEL_DEVICETREE_mt7988_gsw = " \
    mediatek/mt7988a-gsw-10g-spim-nand.dtb \
    "

KERNEL_DEVICETREE_mt7988 = " \
    mediatek/mt7988a-dsa-10g-spim-nand.dtb \
    "

KERNEL_DEVICETREE_mt7988_bpi4 = " \
    mediatek/mt7988a-bananapi-bpi-r4-nand.dtb \
    "

KERNEL_DEVICETREE_mt7986_gsw = " \
    mediatek/mt7986a-2500wan-gsw-spim-nand-rfb.dtb \
    mediatek/mt7986b-2500wan-gsw-spim-nand-rfb.dtb \
    "
KERNEL_DEVICETREE_mt7986 = " \
    mediatek/mt7986a-2500wan-spim-nand-rfb.dtb \
    mediatek/mt7986b-2500wan-spim-nand-rfb.dtb \
    "

KERNEL_DEVICETREE_mt7988_emmc = " \
    mediatek/mt7988a-dsa-10g-emmc.dtb \
    "

KERNEL_DEVICETREE_mt7988_bpi4_emmc = " \
    mediatek/mt7988a-bananapi-bpi-r4-emmc.dtb \
    "

KERNEL_DEVICETREE_mt7986_emmc = " \
    mediatek/mt7986a-emmc-rfb.dtb \
    mediatek/mt7986b-emmc-rfb.dtb \
    "    
KERNEL_IMAGETYPE = "fitImage"
KERNEL_CLASSES = "kernel-fitimage"
KERNEL_CLASSES += "${@bb.utils.contains('DISTRO_FEATURES','secure_boot',' kernel_secure_boot-filogic','',d)}"

UBOOT_CONFIG = "mt7622_rfb_defconfig"

UBOOT_ARCH = "arm64"
UBOOT_LOADADDRESS = "0x48080000"
UBOOT_ENTRYPOINT = "0x48080000"
MACHINE_EXTRA_RRECOMMENDS += "kernel-modules"

TCLIBC = "glibc"

MACHINEOVERRIDES .= ":broadband:filogic"

IMAGE_FSTYPES ="${@bb.utils.contains('DISTRO_FEATURES','kernel_in_ubi',' squashfs-xz',' ubi',d)}"
IMAGE_FSTYPES_DEBUGFS = ""
IMAGE_GEN_DEBUGFS = "0"
# Parameters for MT7986 RFB1 NAND (byte)
# NAND_LOG_BLOCK_SIZE = NAND_PHY_BLOCK_SIZE - 2 Pages
# NAND_LBLOCK_COUNT = NAND_PHY_BLOCK_COUNT - 53
NAND_PAGE_SIZE = "4096"
NAND_PHY_BLOCK_SIZE = "262144"
NAND_LOG_BLOCK_SIZE = "253952"
NAND_PHY_BLOCK_COUNT = "2048"
NAND_LOG_BLOCK_COUNT = "1920"

UBI_VOLNAME = "rootfs"
MKUBIFS_ARGS = "--min-io-size ${NAND_PAGE_SIZE} --leb-size ${NAND_LOG_BLOCK_SIZE} --max-leb-cnt ${NAND_LOG_BLOCK_COUNT}"
UBINIZE_ARGS = "--min-io-size ${NAND_PAGE_SIZE} --peb-size ${NAND_PHY_BLOCK_SIZE} --sub-page-size ${NAND_PAGE_SIZE}"
IMAGE_CLASSES += "image_types-mtk"

SERIAL_CONSOLE ?= "115200 ttyS0"
```

## conf/machine/filogic6-6.conf
```bitbake
#@TYPE: Machine
#@NAME: mediatek filogic
#@NEEDED_BSPLAYERS: meta-filogic
#@DESCRIPTION: Machine configuration for running a RDK broadband on mediatek filogic
#@RDK_FLAVOR: rdkb

DEFAULTTUNE ?= "cortexa53"

include conf/machine/include/soc-family.inc

SOC_FAMILY = "mediatek"

MACHINEOVERRIDES .="${@bb.utils.contains('DISTRO_FEATURES','switch_gsw_mode',':gsw','',d)}"
MACHINEOVERRIDES .="${@bb.utils.contains('DISTRO_FEATURES','emmc',':emmc','',d)}"


KERNEL_DEVICETREE_mt7988_mt7988d = " \
    mediatek/mt7988d-rfb.dtb  \
    "

KERNEL_DEVICETREE_mt7988 = " \
    mediatek/mt7988a-rfb.dtb \
    "

KERNEL_DEVICETREE_mt7988_bpi4 = " \
    mediatek/mt7988a-bananapi-bpi-r4.dtb \
    "

KERNEL_IMAGETYPE = "fitImage"
KERNEL_CLASSES = "kernel-fitimage"
FIT_HASH_ALG ="sha1"
KERNEL_CLASSES += "${@bb.utils.contains('DISTRO_FEATURES','secure_boot',' kernel_secure_boot-filogic','',d)}"
KERNEL_CLASSES += "itb-image"
UBOOT_CONFIG = "mt7622_rfb_defconfig"

UBOOT_ARCH = "arm64"
UBOOT_LOADADDRESS = "0x46000000"
UBOOT_ENTRYPOINT = "0x46000000"
UBOOT_DTB_LOADADDRESS = "0x45f00000"
UBOOT_LOADADDRESS_mt7987 = "0x40080000"
UBOOT_ENTRYPOINT_mt7987 = "0x40080000"
MACHINE_EXTRA_RRECOMMENDS += "kernel-modules"

TCLIBC = "glibc"

MACHINEOVERRIDES .= ":broadband:filogic"

IMAGE_FSTYPES ="${@bb.utils.contains('DISTRO_FEATURES','kernel_in_ubi',' squashfs-xz',' ubi',d)}"
IMAGE_FSTYPES_DEBUGFS = ""
IMAGE_GEN_DEBUGFS = "0"
# Parameters for MT7986 RFB1 NAND (byte)
# NAND_LOG_BLOCK_SIZE = NAND_PHY_BLOCK_SIZE - 2 Pages
# NAND_LBLOCK_COUNT = NAND_PHY_BLOCK_COUNT - 53
NAND_PAGE_SIZE = "4096"
NAND_PHY_BLOCK_SIZE = "262144"
NAND_LOG_BLOCK_SIZE = "253952"
NAND_PHY_BLOCK_COUNT = "2048"
NAND_LOG_BLOCK_COUNT = "1920"

UBI_VOLNAME = "rootfs"
MKUBIFS_ARGS = "--min-io-size ${NAND_PAGE_SIZE} --leb-size ${NAND_LOG_BLOCK_SIZE} --max-leb-cnt ${NAND_LOG_BLOCK_COUNT}"
UBINIZE_ARGS = "--min-io-size ${NAND_PAGE_SIZE} --peb-size ${NAND_PHY_BLOCK_SIZE} --sub-page-size ${NAND_PAGE_SIZE}"
IMAGE_CLASSES += "image_types-mtk"

SERIAL_CONSOLE ?= "115200 ttyS0"


require conf/machine/include/arm/armv8a/tune-cortexa53.inc
```
